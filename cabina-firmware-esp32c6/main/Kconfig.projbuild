## cabina-firmware-esp32c6/main/Kconfig.projbuild
```kconfig
menu "WiFi Configuration"

    config ESP_WIFI_SSID
        string "WiFi SSID"
        default "myssid"
        help
            SSID (network name) for the example to connect to.

    config ESP_WIFI_PASSWORD
        string "WiFi Password"
        default "mypassword"
        help
            WiFi password (WPA or WPA2) for the example to use.

    config ESP_MAXIMUM_RETRY
        int "Maximum retry"
        default 5
        help
            Set the Maximum retry to avoid station reconnecting to the AP unlimited when the AP is really inexistent.

endmenu

menu "VL53L0X Sensor Configuration"

    config VL53L0X_I2C_SDA_GPIO
        int "I2C SDA GPIO Number"
        range 0 50
        default 14
        help
            GPIO number for I2C SDA (data line).

    config VL53L0X_I2C_SCL_GPIO
        int "I2C SCL GPIO Number"
        range 0 50
        default 15
        help
            GPIO number for I2C SCL (clock line).

    config VL53L0X_I2C_CLOCK_SPEED_HZ
        int "I2C Clock Speed (Hz)"
        range 100000 1000000
        default 400000
        help
            I2C clock speed in Hz. Standard speeds: 100kHz, 400kHz, 1MHz.

    config VL53L0X_TIMING_BUDGET_MS
        int "Timing Budget (ms)"
        range 10 1000
        default 33
        help
            Measurement timing budget in milliseconds. Lower values = faster but less accurate.

    config VL53L0X_INTER_MEASUREMENT_PERIOD_MS
        int "Inter-Measurement Period (ms)"
        range 10 1000
        default 50
        help
            Time between measurements in milliseconds. Must be >= timing budget.

endmenu
```

## cabina-firmware/main/Kconfig.projbuild
```kconfig
menu "Example Configuration"

    choice EXAMPLE_HARDWARE
        prompt "Hardware"
        default EXAMPLE_HARDWARE_QTPY
        help
            Select the hardware to run this example on.

        config EXAMPLE_HARDWARE_QTPY
            bool "QtPy ESP32 Pico or QtPy ESP32-S3"

        config EXAMPLE_HARDWARE_CUSTOM
            bool "Custom"
    endchoice

    config EXAMPLE_I2C_SCL_GPIO
        int "SCL GPIO Num"
        range 0 50
        default 40 if EXAMPLE_HARDWARE_QTPY && IDF_TARGET_ESP32S3
        default 15 if EXAMPLE_HARDWARE_QTPY && IDF_TARGET_ESP32C6
        default 19 if EXAMPLE_HARDWARE_QTPY && IDF_TARGET_ESP32
        default 19 if EXAMPLE_HARDWARE_CUSTOM
        help
            GPIO number for I2C Master clock line.

    config EXAMPLE_I2C_SDA_GPIO
        int "SDA GPIO Num"
        range 0 50
        default 41 if EXAMPLE_HARDWARE_QTPY && IDF_TARGET_ESP32S3
        default 14 if EXAMPLE_HARDWARE_QTPY && IDF_TARGET_ESP32C6
        default 22 if EXAMPLE_HARDWARE_QTPY && IDF_TARGET_ESP32
        default 22 if EXAMPLE_HARDWARE_CUSTOM
        help
            GPIO number for I2C Master data line.

    config EXAMPLE_I2C_CLOCK_SPEED_HZ
        int "I2C Clock Speed"
        range 100 1000000
        default 400000
        help
            I2C clock speed in Hz.

    config EXAMPLE_WIFI_SSID
        string "Wi-Fi SSID"
        default "YourWiFiNetwork"
        help
            SSID (network name) for the Wi-Fi connection.

    config EXAMPLE_WIFI_PASSWORD
        string "Wi-Fi Password"
        default "YourWiFiPassword"
        help
            Password for the Wi-Fi network.

    config EXAMPLE_WIFI_MAX_RETRY
        int "Wi-Fi Maximum Connection Retries"
        range 1 20
        default 5
        help
            Maximum number of retry attempts when connecting to Wi-Fi.

    config EXAMPLE_MQTT_BROKER
        string "MQTT Broker Address"
        default "192.168.1.10"
        help
            MQTT broker hostname or IP address.

    config EXAMPLE_MQTT_PORT
        int "MQTT Broker Port"
        range 1 65535
        default 1883
        help
            MQTT broker port number.

    config EXAMPLE_MQTT_USER
        string "MQTT Username"
        default ""
        help
            MQTT username (leave empty if no authentication required).

    config EXAMPLE_MQTT_PASSWORD
        string "MQTT Password"
        default ""
        help
            MQTT password (leave empty if no authentication required).

    config EXAMPLE_MQTT_TOPIC_BASE
        string "MQTT Topic Base"
        default "parking"
        help
            Base topic for MQTT messages. Full topic will be: {base}/{site_id}/{device_id}/{subtopic}

    config EXAMPLE_MQTT_SITE_ID
        string "MQTT Site ID"
        default "default-site"
        help
            Site identifier for MQTT topic construction.

    config EXAMPLE_MQTT_DEVICE_ID
        string "MQTT Device ID"
        default "cabina-01"
        help
            Device identifier for MQTT topic construction.

    config EXAMPLE_IR1_GPIO
        int "IR Sensor 1 GPIO Pin"
        range 0 50
        default 2
        help
            GPIO pin number for IR presence sensor 1.

    config EXAMPLE_IR2_GPIO
        int "IR Sensor 2 GPIO Pin"
        range 0 50
        default 3
        help
            GPIO pin number for IR presence sensor 2.

    config EXAMPLE_IR_PULLUPS
        bool "Enable pull-ups for IR sensors"
        default y
        help
            Enable internal pull-ups for IR sensor inputs. If enabled, high level means presence detected.
            If disabled, low level means presence detected.

    config EXAMPLE_DISTANCE_THRESHOLD_MM
        int "Distance Change Threshold (mm)"
        range 5 200
        default 20
        help
            Minimum distance change (in mm) required to trigger a distance event.
            Smaller values = more sensitive, larger values = less sensitive.

    config EXAMPLE_PRESENCE_RETAIN
        bool "Retain presence messages"
        default y
        help
            Whether to retain IR presence messages on MQTT broker.

    config EXAMPLE_STATUS_INTERVAL_SEC
        int "Status Heartbeat Interval (seconds)"
        range 1 3600
        default 10
        help
            Interval for publishing status heartbeat messages to MQTT.

    menu "OTA Update Configuration"
        config EXAMPLE_OTA_VALIDATION_TIMEOUT_SEC
            int "OTA Validation Timeout (seconds)"
            range 10 300
            default 60
            help
                Time in seconds after boot to validate firmware after OTA update.
                If validation is not confirmed within this time, the device will
                rollback to the previous firmware version.

        config EXAMPLE_OTA_SKIP_CERT_VERIFY
            bool "Skip HTTPS certificate verification (development only)"
            default n
            help
                Skip certificate verification for HTTPS OTA downloads.
                WARNING: Only enable for development/testing. Insecure for production!

        config EXAMPLE_OTA_AUTO_VALIDATE
            bool "Auto-validate firmware after successful init"
            default y
            help
                Automatically mark firmware as valid after successful initialization.
                If disabled, the application must explicitly call ota_update_mark_valid().

        config EXAMPLE_OTA_VERSION_PUBLISH_ON_BOOT
            bool "Publish firmware version on boot"
            default y
            help
                Publish the current firmware version to MQTT when the device boots.
    endmenu

endmenu
```

## motor-control/main/Kconfig.projbuild
```kconfig
menu "Motor Control Configuration"

config MOTOR_CONTROL_RELAY_GPIO
    int "Relay GPIO number"
    range 0 48
    default 10

config MOTOR_CONTROL_RELAY_ACTIVE_HIGH
    bool "Relay turns on with logic HIGH"
    default y

config MOTOR_CONTROL_WIFI_SSID
    string "Wi-Fi SSID"
    default ""

config MOTOR_CONTROL_WIFI_PASSWORD
    string "Wi-Fi password"
    default ""

config MOTOR_CONTROL_MQTT_URI
    string "MQTT broker URI"
    default "mqtt://192.168.1.50:1883"

config MOTOR_CONTROL_MQTT_USERNAME
    string "MQTT username"
    default ""

config MOTOR_CONTROL_MQTT_PASSWORD
    string "MQTT password"
    default ""

config MOTOR_CONTROL_MQTT_CLIENT_ID
    string "MQTT client ID"
    default "motor-control"

config MOTOR_CONTROL_MQTT_TOPIC
    string "MQTT command topic"
    default "parking/garage-01/motor"

config MOTOR_CONTROL_MQTT_QOS
    int "MQTT subscription QoS"
    range 0 2
    default 1

endmenu
```

## motor-control/sdkconfig.defaults
```kconfig
CONFIG_IDF_TARGET="esp32s3"
CONFIG_IDF_TARGET_ESP32S3=y

CONFIG_MOTOR_CONTROL_RELAY_GPIO=10
CONFIG_MOTOR_CONTROL_RELAY_ACTIVE_HIGH=y
CONFIG_MOTOR_CONTROL_WIFI_SSID=""
CONFIG_MOTOR_CONTROL_WIFI_PASSWORD=""
CONFIG_MOTOR_CONTROL_MQTT_URI="mqtt://192.168.1.50:1883"
CONFIG_MOTOR_CONTROL_MQTT_USERNAME=""
CONFIG_MOTOR_CONTROL_MQTT_PASSWORD=""
CONFIG_MOTOR_CONTROL_MQTT_CLIENT_ID="motor-control"
CONFIG_MOTOR_CONTROL_MQTT_TOPIC="parking/garage-01/motor"
CONFIG_MOTOR_CONTROL_MQTT_QOS=1
```

## z_playground/cabina_first_attempt/main/Kconfig.projbuild
```kconfig
menu "Cabina Firmware Configuration"

config CABINA_WIFI_SSID
    string "Wi-Fi SSID"
    default "YourWiFiNetwork"

config CABINA_WIFI_PASSWORD
    string "Wi-Fi Password"
    default "YourWiFiPassword"

config CABINA_MQTT_BROKER
    string "MQTT broker address"
    default "192.168.1.10"

config CABINA_MQTT_PORT
    int "MQTT port"
    default 1883

config CABINA_MQTT_USER
    string "MQTT username"
    default ""

config CABINA_MQTT_PASSWORD
    string "MQTT password"
    default ""

config CABINA_TOPIC_BASE
    string "MQTT topic base"
    default "parking"

config CABINA_SITE_ID
    string "Site ID"
    default "default-site"

config CABINA_DEVICE_ID
    string "Device ID (blank=derive from MAC)"
    default ""

config CABINA_PRESENCE_RETAIN
    bool "Retain presence messages"
    default y

config CABINA_PUB_INTERVAL_SEC
    int "Telemetry publish interval (seconds)"
    default 10
    range 1 3600

config CABINA_SAMPLE_PERIOD_MS
    int "Sensor sample period (ms)"
    default 50
    range 5 1000

config CABINA_DISTANCE_THRESHOLD_MM
    int "Distance change threshold for events (mm)"
    default 20
    range 5 200
    help
        Minimum distance change (in mm) required to trigger a distance event.
        Smaller values = more sensitive, larger values = less sensitive.
        Default 20mm matches CircuitPython implementation.

config CABINA_IR_PULLUPS
    bool "Enable internal pull-ups for IR inputs"
    default y

comment "Pin map - ESP32-S3"

config CABINA_S3_I2C_SCL
    int "ESP32-S3 I2C SCL pin"
    default 9
config CABINA_S3_I2C_SDA
    int "ESP32-S3 I2C SDA pin"
    default 8
config CABINA_S3_IR1_GPIO
    int "ESP32-S3 IR1 GPIO"
    default 2
config CABINA_S3_IR2_GPIO
    int "ESP32-S3 IR2 GPIO"
    default 3

comment "Pin map - ESP32-C6"

config CABINA_C6_I2C_SCL
    int "ESP32-C6 I2C SCL pin"
    default 15
config CABINA_C6_I2C_SDA
    int "ESP32-C6 I2C SDA pin"
    default 14
config CABINA_C6_IR1_GPIO
    int "ESP32-C6 IR1 GPIO"
    default 2
config CABINA_C6_IR2_GPIO
    int "ESP32-C6 IR2 GPIO"
    default 3

endmenu
```
